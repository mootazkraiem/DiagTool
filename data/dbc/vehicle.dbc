VERSION ""

NS_ :

BS_:

BU_:

BO_ 256 EngineData: 8 Vector__XXX
 SG_ EngineRPM : 0|16@1+ (1,0) [0|65535] "rpm" Vector__XXX
 SG_ EngineTemp : 16|8@1+ (1,-40) [-40|215] "degC" Vector__XXX

BO_ 512 BatteryStatus: 8 Vector__XXX
 SG_ SOC : 0|8@1+ (0.5,0) [0|100] "%" Vector__XXX
 SG_ Voltage : 8|16@1+ (0.1,0) [0|1000] "V" Vector__XXX

BO_ 1024 EmptyMsg: 8 Vector__XXX
